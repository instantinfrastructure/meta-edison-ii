## conf/distro/poky-edison.conf
```bitbake
#require conf/distro/poky.conf
#require conf/distro/poky-edison.conf

#PREFERRED_PROVIDER_virtual/kernel ?= "linux-yocto"
PREFERRED_VERSION_linux-yocto = "3.19%"
```

## conf/layer.conf
```bitbake
# We have a conf and classes directory, add to BBPATH
BBPATH := "${BBPATH}:${LAYERDIR}"

# We have a recipes-* directories, add to BBFILES
BBFILES := "${BBFILES} ${LAYERDIR}/recipes-*/*/*.bb \
	${LAYERDIR}/recipes-*/*/*.bbappend"

BBFILE_COLLECTIONS += "edison-ii"
BBFILE_PATTERN_edison-ii = "^${LAYERDIR}/"
BBFILE_PRIORITY_edison-ii = "6"
LINUX_VERSION = "3.19.0"
```
